# netx90_app register map
File version: 1.0
netX 90 Application CPU
CPU: CM4 r0p1, little endian, MPU, FPU, 4 interrupt priority bits, 78 interrupts
Registers are 32-bit, read-write, reset 0x0 unless marked. A register's access mark holds for its fields unless they carry their own. Offsets are from the block's base; lines under a group give offsets from that group; [hi:lo] are bit positions; {n}, {i} and the like mark numbered series; 'fields as' and 'values as' point back to an identical list; <NAME> marks a mode.

## Memory map
0xE000E000 cm4_scs size 0x1000
0xE0043000 cm4_misc_ctrl size 0x1000
0xFF001B00 idpm_com size 0x100
0xFF080000 hash size 0x80
0xFF080100 hash_ctx_sha size 0x100
0xFF080200 hash_ctx_md5 size 0x20
0xFF080300 aes size 0x40
0xFF080340 random size 0x8
0xFF082000 mtgy size 0x2000
0xFF400000 nfifo size 0x1000
0xFF401000 pad_ctrl size 0x200
0xFF401200 asic_ctrl size 0x100
0xFF401300 mmio_ctrl size 0x80
0xFF401400 iflash_cfg2 size 0x80
0xFF401480 hif_io_ctrl size 0x40
0xFF401500 hif_asyncmem_ctrl size 0x40
0xFF401540 hif_sdram_ctrl size 0x40
0xFF401580 hifmem_priority_ctrl size 0x40
0xFF401640 sqi size 0x40
0xFF401680 uart size 0x40
0xFF4016C0 ahb_abort size 0x10 — abort
0xFF4016D0 sample_at_porn_stat size 0x10
0xFF401700 slave_firewall_ctrl size 0x40
0xFF401740 module_firewall_ctrl size 0x40
0xFF401780 ecc_ctrl size 0x20
0xFF4017E0 madc size 0x20
0xFF401800 madc_seq0 size 0x100
0xFF401900 madc_seq1 size 0x100
0xFF401A00 madc_seq2 size 0x100
0xFF401B00 madc_seq3 size 0x100
0xFF480000 eth size 0x40
{0xFF800100+0x20*n} dmac_app_ch[{n}] (n=0..3) size 0x20 — dmac_app_ch0
0xFF800800 dmac_app_reg size 0x800
0xFF801000 dmac_mux_app size 0x40
0xFF801040 uart_app size 0x40
0xFF801080 i2c_app size 0x40
0xFF8010C0 spi0_app size 0x40
0xFF801100 spi1_app size 0x40
0xFF801140 spi2_app size 0x40
0xFF801180 sqi0_app size 0x40
0xFF8011C0 sqi1_app size 0x40
0xFF801200 can_ctrl0_app size 0x80
0xFF801280 can_ctrl1_app size 0x80
0xFF801300 mled_ctrl_app size 0x100
0xFF801400 gpio_app size 0x100
0xFF801500 pio_app size 0x100
0xFF801600 timer_app size 0x80
0xFF801680 systime_lt_app size 0x40
0xFF8016C0 systime_app size 0x10
0xFF8016E0 mcp_app size 0x20
0xFF801700 wdg_app size 0x20
0xFF801720 trigger_irq_app size 0x20
0xFF801800 ecc_ctrl_app size 0x40
0xFF802000 endat0_app size 0x40
0xFF802040 endat1_app size 0x40
0xFF802080 endat_ctrl0_app size 0x10
0xFF802090 endat_ctrl1_app size 0x10
0xFF8020A0 biss_ctrl0_app size 0x20
0xFF8020C0 biss_ctrl1_app size 0x20
0xFF802100 biss0_app size 0x100
0xFF802200 biss1_app size 0x100
0xFF802300 menc_app size 0x80
0xFF802400 mpwm_app size 0x200
0xFF884000 xpic_app_regs size 0x80
0xFF884080 xpic_app_debug size 0x80
0xFF900000 vic_xpic_app size 0x100
0xFF900100 timer_xpic_app size 0x80
0xFF900180 wdg_xpic_app size 0x20
0xFF9001A0 mcp_xpic_app size 0x20
0xFF9001C0 systime_lt_xpic_app size 0x40
0xFF900200 gpio_xpic_app size 0x100
0xFF900300 uart_xpic_app size 0x40
0xFF900340 i2c_xpic_app size 0x40
0xFF900380 spi_xpic_app size 0x40
{0xFF900400+0x10*n} xlink{n} size 0x10 (n=0..7)
0xFF900480 io_link_irq size 0x20

## Interrupts
1 timer_app0 (timer_app)
2 timer_app1 (timer_app)
3 timer_app2 (timer_app)
4 timer_app_systime_s (timer_app)
5 wdg_app
6 dmac_app (dmac_app_reg)
7 mcp_app
8 uart
9 i2c_app
10 i2c_xpic_app
11 ecc_app (ecc_ctrl_app)
12 xpic_debug_app (xpic_app_debug)
13 wdg_xpic_app_arm (xpic_app_debug)
14 nfifo_arm_app (nfifo)
15 io_link_irq_xpic_app (io_link_irq)
16 spi0_app
17 spi1_app
18 spi2_app
19 spi_xpic_app
20 uart_app
21 uart_xpic_app
22 bod (asic_ctrl)
23 clk_sup (asic_ctrl)
24 sqi
25 hif_pio_arm (hif_io_ctrl)
26 eth
27 hash
28 aes
29 mtgy
30 hif_rdy_to (hif_io_ctrl)
31 idpm_com_host (idpm_com)
{n+32} hs_com_host_hsc{n} (idpm_com) (n=0..7)
40 hs_com_host_hsc8to15 (idpm_com)
41 endat_app0 (endat0_app)
42 endat_app1 (endat1_app)
43 biss_app0 (biss0_app)
44 biss_app1 (biss1_app)
45 madc_seq0
46 madc_seq1
47 madc_seq2
48 madc_seq3
49 mpwm (mpwm_app)
50 menc_app_irq_enc0 (menc_app)
51 menc_app_irq_enc1 (menc_app)
52 menc_app_irq_cap_mp (menc_app)
53 menc_app_irq_err (menc_app)
{n+54} gpio_app{n} (gpio_app) (n=0..7)
62 gpio_app_timer0 (gpio_app)
63 gpio_app_timer1 (gpio_app)
64 gpio_app_timer2 (gpio_app)
65 pio0_app (pio_app)
66 pio1_app (pio_app)
67 pio2_app (pio_app)
68 pio3_app (pio_app)
69 trigger_out_edge0 (trigger_irq_app)
70 trigger_out_edge1 (trigger_irq_app)
71 can_ctrl0_app
72 can_ctrl1_app
73 sqi0_app
74 sqi1_app
77 fpu_arm_app (cm4_misc_ctrl)
